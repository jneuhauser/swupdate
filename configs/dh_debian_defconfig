## configs/dh_debian_defconfig
```kconfig
CONFIG_SYSTEMD=y
CONFIG_HW_COMPATIBILITY=y
CONFIG_LUAPKG="lua5.2"
CONFIG_EXTRA_CFLAGS="-g"
CONFIG_DOWNLOAD=y
CONFIG_DOWNLOAD_SSL=y
CONFIG_SIGNED_IMAGES=y
CONFIG_ENCRYPTED_IMAGES=y
CONFIG_SURICATTA=y
CONFIG_SURICATTA_SSL=y
CONFIG_SURICATTA_STATE_CHOICE_BOOTLOADER=y
CONFIG_WEBSERVER=y
CONFIG_MONGOOSESSL=y
CONFIG_UBIVOL=y
# CONFIG_UBIATTACH is not set
CONFIG_CFI=y
CONFIG_CFIHAMMING1=y
CONFIG_RAW=y
CONFIG_LUASCRIPTHANDLER=y
CONFIG_SHELLSCRIPTHANDLER=y
CONFIG_HANDLER_IN_LUA=y
CONFIG_ARCHIVE=y
CONFIG_REMOTE_HANDLER=y
CONFIG_SWUFORWARDER_HANDLER=y
CONFIG_BOOTLOADERHANDLER=y
```
